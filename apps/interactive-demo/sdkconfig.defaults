## apps/interactive-demo/sdkconfig.defaults
```kconfig
CONFIG_LOG_DEFAULT_LEVEL_INFO=y
CONFIG_ESP_CONSOLE_USB_SERIAL_JTAG=y
CONFIG_ESP_CONSOLE_SECONDARY_NONE=y
CONFIG_FREERTOS_HZ=1000
CONFIG_ESP_MAIN_TASK_STACK_SIZE=12288
CONFIG_LV_COLOR_DEPTH_24=y
CONFIG_LV_USE_DEMO_WIDGETS=n
```

## apps/lvgl-widgets/sdkconfig.defaults
```kconfig
CONFIG_LOG_DEFAULT_LEVEL_INFO=y
CONFIG_ESP_CONSOLE_USB_SERIAL_JTAG=y
CONFIG_ESP_CONSOLE_SECONDARY_NONE=y
CONFIG_FREERTOS_HZ=1000
CONFIG_ESP_MAIN_TASK_STACK_SIZE=12288
CONFIG_SPIRAM_USE_MALLOC=y
CONFIG_LV_COLOR_DEPTH_24=y
CONFIG_LV_USE_CLIB_MALLOC=y
CONFIG_LV_BUILD_EXAMPLES=n
CONFIG_LV_USE_DEMO_WIDGETS=y
CONFIG_LV_FONT_MONTSERRAT_14=y
CONFIG_LV_FONT_MONTSERRAT_16=y
CONFIG_LV_FONT_MONTSERRAT_24=y
CONFIG_LV_USE_SYSMON=y
CONFIG_LV_USE_PERF_MONITOR=y
```

## apps/panel-test/main/Kconfig.projbuild
```kconfig
menu "KMYC panel test"

config KMYC_PANEL_INTERNAL_BIST
    bool "Use panel-internal BIST (DPI video stays off)"
    default y
    help
        Preserve the original diagnostic baseline. Disable only when testing
        the ESP32 hardware color bars. Neither mode implies visual validation.

config KMYC_PATTERN_PERIOD_MS
    int "Heartbeat / pattern interval (milliseconds)"
    range 100 60000
    default 2000

endmenu
```
